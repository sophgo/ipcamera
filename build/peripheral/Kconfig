## build/peripheral/Kconfig
```kconfig
menu "peripheral support list"

menu "sensor support list"

config SENSOR_CVSENS_CV2003
	bool "SENSOR_CVSENS_CV2003"
	help
		"enable SENSOR_CVSENS_CV2003"

config SENSOR_CVSENS_CV2003_1L_SLAVE
	bool "SENSOR_CVSENS_CV2003_1L_SLAVE"
	help
		"enable SENSOR_CVSENS_CV2003_1L_SLAVE"

config SENSOR_CVSENS_CV2003_1L_SLAVE1
	bool "SENSOR_CVSENS_CV2003_1L_SLAVE1"
	help
		"enable SENSOR_CVSENS_CV2003_1L_SLAVE1"

config SENSOR_CVSENS_CV4001
	bool "SENSOR_CVSENS_CV4001"
	help
		"enable SENSOR_CVSENS_CV4001"

config SENSOR_GCORE_GC1054
	bool "SENSOR_GCORE_GC1054"
	help
		"enable SENSOR_GCORE_GC1054"

config SENSOR_GCORE_GC1084
	bool "SENSOR_GCORE_GC1084"
	help
		"enable SENSOR_GCORE_GC1084"

config SENSOR_GCORE_GC1084_SLAVE
	bool "SENSOR_GCORE_GC1084_SLAVE"
	help
		"enable SENSOR_GCORE_GC1084_SLAVE"

config SENSOR_GCORE_GC1084_SLAVE1
	bool "SENSOR_GCORE_GC1084_SLAVE1"
	help
		"enable SENSOR_GCORE_GC1084_SLAVE1"

config SENSOR_GCORE_GC1084_SLAVE2
	bool "SENSOR_GCORE_GC1084_SLAVE2"
	help
		"enable SENSOR_GCORE_GC1084_SLAVE2"

config SENSOR_GCORE_GC2053
	bool "SENSOR_GCORE_GC2053"
	help
		"enable SENSOR_GCORE_GC2053"

config SENSOR_GCORE_GC2053_SLAVE
bool "SENSOR_GCORE_GC2053_SLAVE"
help
	"enable SENSOR_GCORE_GC2053_SLAVE"

config SENSOR_GCORE_GC2093_SLAVE
bool "SENSOR_GCORE_GC2093_SLAVE"
help
	"enable SENSOR_GCORE_GC2093_SLAVE"

config SENSOR_GCORE_GC4023
bool "SENSOR_GCORE_GC4023"
help
	"enable SENSOR_GCORE_GC4023"

config SENSOR_GCORE_GC4653
bool "SENSOR_GCORE_GC4653"
help
	"enable SENSOR_GCORE_GC4653"

config SENSOR_GCORE_GC4653_SLAVE
bool "SENSOR_GCORE_GC4653_SLAVE"
help
	"enable SENSOR_GCORE_GC4653_SLAVE"

config SENSOR_NEXTCHIP_N5
bool "SENSOR_NEXTCHIP_N5"
help
	"enable SENSOR_NEXTCHIP_N5"

config SENSOR_NEXTCHIP_N6
bool "SENSOR_NEXTCHIP_N6"
help
	"enable SENSOR_NEXTCHIP_N6"

config SENSOR_OV_OS02H10
bool "SENSOR_OV_OS02H10"
help
	"enable SENSOR_OV_OS02H10"

config SENSOR_OV_OS03B10
bool "SENSOR_OV_OS03B10"
help
	"enable SENSOR_OV_OS03B10"

config SENSOR_OV_OS04A10
bool "SENSOR_OV_OS04A10"
help
	"enable SENSOR_OV_OS04A10"

config SENSOR_OV_OS04C10
bool "SENSOR_OV_OS04C10"
help
	"enable SENSOR_OV_OS04C10"

config SENSOR_OV_OS04E10
bool "SENSOR_OV_OS04E10"
help
	"enable SENSOR_OV_OS04E10"

config SENSOR_OV_OS04E10_SLAVE
bool "SENSOR_OV_OS04E10_SLAVE"
help
	"enable SENSOR_OV_OS04E10_SLAVE"

config SENSOR_OV_OV4689
bool "SENSOR_OV_OV4689"
help
	"enable SENSOR_OV_OV4689"

config SENSOR_OV_OV5647
bool "SENSOR_OV_OV5647"
help
	"enable SENSOR_OV_OV5647"

config SENSOR_OV_OS08A20
bool "SENSOR_OV_OS08A20"
help
	"enable SENSOR_OV_OS08A20"

config SENSOR_OV_OS08A20_SLAVE
bool "SENSOR_OV_OS08A20_SLAVE"
help
	"enable SENSOR_OV_OS08A20_SLAVE"

config SENSOR_PICO_384
bool "SENSOR_PICO_384"
help
	"enable SENSOR_PICO_384"

config SENSOR_PICO_640
bool "SENSOR_PICO_640"
help
	"enable SENSOR_PICO_640"

config SENSOR_PIXELPLUS_PR2020
bool "SENSOR_PIXELPLUS_PR2020"
help
	"enable SENSOR_PIXELPLUS_PR2020"

config SENSOR_PIXELPLUS_PR2100
bool "SENSOR_PIXELPLUS_PR2100"
help
	"enable SENSOR_PIXELPLUS_PR2100"

config SENSOR_SMS_SC1346_1L
bool "SENSOR_SMS_SC1346_1L"
help
	"enable SENSOR_SMS_SC1346_1L"

config SENSOR_SMS_SC200AI
bool "SENSOR_SMS_SC200AI"
help
	"enable SENSOR_SMS_SC200AI"

config SENSOR_SMS_SC2335
bool "SENSOR_SMS_SC2335"
help
	"enable SENSOR_SMS_SC2335"

config SENSOR_SMS_SC2336
bool "SENSOR_SMS_SC2336"
help
	"enable SENSOR_SMS_SC2336"

config SENSOR_SMS_SC2336_SLAVE
bool "SENSOR_SMS_SC2336_SLAVE"
help
	"enable SENSOR_SMS_SC2336_SLAVE"

config SENSOR_SMS_SC2336_SLAVE1
bool "SENSOR_SMS_SC2336_SLAVE1"
help
	"enable SENSOR_SMS_SC2336_SLAVE1"

config SENSOR_SMS_SC2336P
bool "SENSOR_SMS_SC2336P"
help
	"enable SENSOR_SMS_SC2336P"
	
config SENSOR_SMS_SC2336_1L
bool "SENSOR_SMS_SC2336_1L"
help
	"enable SENSOR_SMS_SC2336_1L"

config SENSOR_SMS_SC500AI
bool "SENSOR_SMS_SC500AI"
help
	"enable SENSOR_SMS_SC500AI"

config SENSOR_SMS_SC501AI_2L
bool "SENSOR_SMS_SC501AI_2L"
help
	"enable SENSOR_SMS_SC501AI_2L"

config SENSOR_SMS_SC531AI_2L
bool "SENSOR_SMS_SC531AI_2L"
help
	"enable SENSOR_SMS_SC531AI_2L"

config SENSOR_SMS_SC5336_2L
bool "SENSOR_SMS_SC5336_2L"
help
	"enable SENSOR_SMS_SC5336_2L"

config SENSOR_SMS_SC4336P
bool "SENSOR_SMS_SC4336P"
help
	"enable SENSOR_SMS_SC4336P"

config SENSOR_SMS_SC4336P_SLAVE
bool "SENSOR_SMS_SC4336P_SLAVE"
help
	"enable SENSOR_SMS_SC4336P_SLAVE"

config SENSOR_SMS_SC3332
bool "SENSOR_SMS_SC3332"
help
	"enable SENSOR_SMS_SC3332"

config SENSOR_SMS_SC3335
bool "SENSOR_SMS_SC3335"
help
	"enable SENSOR_SMS_SC3335"

config SENSOR_SMS_SC3335_SLAVE
bool "SENSOR_SMS_SC3335_SLAVE"
help
	"enable SENSOR_SMS_SC3335_SLAVE"

config SENSOR_SMS_SC3336
bool "SENSOR_SMS_SC3336"
help
	"enable SENSOR_SMS_SC3336"

config SENSOR_SMS_SC2335
bool "SENSOR_SMS_SC2335"
help
	"enable SENSOR_SMS_SC2335"

config SENSOR_SMS_SC4336
bool "SENSOR_SMS_SC4336"
help
	"enable SENSOR_SMS_SC4336"

config SENSOR_SMS_SC8238
bool "SENSOR_SMS_SC8238"
help
	"enable SENSOR_SMS_SC8238"

config SENSOR_SMS_SC4210
bool "SENSOR_SMS_SC4210"
help
	"enable SENSOR_SMS_SC4210"

config SENSOR_SMS_SC401AI
bool "SENSOR_SMS_SC401AI"
help
	"enable SENSOR_SMS_SC401AI"

config SENSOR_SOI_F23
bool "SENSOR_SOI_F23"
help
	"enable SENSOR_SOI_F23"

config SENSOR_SOI_F35
bool "SENSOR_SOI_F35"
help
	"enable SENSOR_SOI_F35"

config SENSOR_SOI_F35_SLAVE
bool "SENSOR_SOI_F35_SLAVE"
help
	"enable SENSOR_SOI_F35_SLAVE"

config SENSOR_SOI_F38P
bool "SENSOR_SOI_F38P"
help
	"enable SENSOR_SOI_F38P"

config SENSOR_SOI_H65
bool "SENSOR_SOI_H65"
help
	"enable SENSOR_SOI_H65"

config SENSOR_SOI_K06
bool "SENSOR_SOI_K06"
help
	"enable SENSOR_SOI_K06"

config SENSOR_SOI_K04
	bool "SENSOR_SOI_K04"
	help
		"enable SENSOR_SOI_K04"

config SENSOR_SONY_IMX290_2LOI_F23
bool "SENSOR_SONY_IMX290_2L"
help
	"enable SENSOR_SONY_IMX290_2L"

config SENSOR_SONY_IMX307
	bool "SENSOR_SONY_IMX307"
	help
		"enable SENSOR_SONY_IMX307"

		
config SENSOR_SONY_IMX307_2L
bool "SENSOR_SONY_IMX307_2L"
help
	"enable SENSOR_SONY_IMX307_2L"

config SENSOR_SONY_IMX307_SLAVE
bool "SENSOR_SONY_IMX307_SLAVE"
help
	"enable SENSOR_SONY_IMX307_SLAVE"

config SENSOR_SONY_IMX307_SUBLVDS
bool "SENSOR_SONY_IMX307_SUBLVDS"
help
	"enable SENSOR_SONY_IMX307_SUBLVDS"

config SENSOR_SONY_IMX327
bool "SENSOR_SONY_IMX327"
help
	"enable SENSOR_SONY_IMX327"

config SENSOR_SONY_IMX327_2L
bool "SENSOR_SONY_IMX327_2L"
help
	"enable SENSOR_SONY_IMX327_2L"

config SENSOR_SONY_IMX327_SLAVE
bool "SENSOR_SONY_IMX327_SLAVE"
help
	"enable SENSOR_SONY_IMX327_SLAVE"

config SENSOR_SONY_IMX327_SUBLVDS
bool "SENSOR_SONY_IMX327_SUBLVDS"
help
	"enable SENSOR_SONY_IMX327_SUBLVDS"

config SENSOR_SONY_IMX327_10BIT
bool "SENSOR_SONY_IMX327_10BIT"
help
	"enable SENSOR_SONY_IMX327_10BIT"

config SENSOR_SONY_IMX334
bool "SENSOR_SONY_IMX334"
help
	"enable SENSOR_SONY_IMX334"

config SENSOR_SONY_IMX335
bool "SENSOR_SONY_IMX335"
help
	"enable SENSOR_SONY_IMX335"

config SENSOR_SONY_IMX385
bool "SENSOR_SONY_IMX385"
help
	"enable SENSOR_SONY_IMX385"

config SENSOR_VIVO_MCS369Q
bool "SENSOR_VIVO_MCS369Q"
help
	"enable SENSOR_VIVO_MCS369Q"

config SENSOR_VIVO_MCS369
bool "SENSOR_VIVO_MCS369"
help
	"enable SENSOR_VIVO_MCS369"

config SENSOR_VIVO_MM308M2
bool "SENSOR_VIVO_MM308M2"
help
	"enable SENSOR_VIVO_MM308M2"

config SENSOR_SONY_IMX327_FPGA
bool "SENSOR_SONY_IMX327_FPGA"
help
	"enable SENSOR_SONY_IMX327_FPGA"

config SENSOR_SONY_IMX347
bool "SENSOR_SONY_IMX347"
help
	"enable SENSOR_SONY_IMX347"

config SENSOR_GCORE_GC2053_1L
bool "SENSOR_GCORE_GC2053_1L"
help
	"enable SENSOR_GCORE_GC2053_1L"

config SENSOR_SMS_SC035HGS
bool "SENSOR_SMS_SC035HGS"
help
	"enable SENSOR_SMS_SC035HGS"

config SENSOR_SMS_SC035GS
bool "SENSOR_SMS_SC035GS"
help
	"enable SENSOR_SMS_SC035GS"

config SENSOR_IMGDS_MIS2008
bool "SENSOR_IMGDS_MIS2008"
help
	"enable SENSOR_IMGDS_MIS2008"

config SENSOR_SMS_SC2331_1L
bool "SENSOR_SMS_SC2331_1L"
help
	"enable SENSOR_SMS_SC2331_1L"

config SENSOR_SMS_SC2331_1L_SLAVE
bool "SENSOR_SMS_SC2331_1L_SLAVE"
help
	"enable SENSOR_SMS_SC2331_1L_SLAVE"

config SENSOR_SMS_SC2331_1L_SLAVE1
bool "SENSOR_SMS_SC2331_1L_SLAVE1"
help
	"enable SENSOR_SMS_SC2331_1L_SLAVE1"

endmenu

menu "panel support list"

config MIPI_PANEL_HX8394
bool "MIPI_PANEL_HX8394"
help
	"enable MIPI_PANEL_HX8394"

config MIPI_PANEL_ILI9881C
bool "MIPI_PANEL_ILI9881C"
help
	"enable MIPI_PANEL_ILI9881C"

config MIPI_PANEL_ILI9881D
bool "MIPI_PANEL_ILI9881D"
help
	"enable MIPI_PANEL_ILI9881D"

config MIPI_PANEL_JD9366AB
bool "MIPI_PANEL_JD9366AB"
help
	"enable MIPI_PANEL_JD9366AB"

config MIPI_PANEL_NT35521
bool "MIPI_PANEL_NT35521"
help
	"enable MIPI_PANEL_NT35521"

config MIPI_PANEL_OTA7290B
bool "MIPI_PANEL_OTA7290B"
help
	"enable MIPI_PANEL_OTA7290B"

config MIPI_PANEL_OTA7290B_1920
bool "MIPI_PANEL_OTA7290B_1920"
help
	"enable MIPI_PANEL_OTA7290B_1920"

config MIPI_PANEL_ICN9707
bool "MIPI_PANEL_ICN9707"
help
	"enable MIPI_PANEL_ICN9707"

config MIPI_PANEL_3AML069LP01G
bool "MIPI_PANEL_3AML069LP01G"
help
	"enable MIPI_PANEL_3AML069LP01G"

config MIPI_PANEL_ST7701
bool "MIPI_PANEL_ST7701"
help
	"enable MIPI_PANEL_ST7701"

config MIPI_PANEL_4_LANES
bool "MIPI_PANEL_4_LANES"
help
	"enable MIPI_PANEL_4_LANES"

config MIPI_PANEL_2_LANES
bool "MIPI_PANEL_2_LANES"
help
	"enable MIPI_PANEL_2_LANES"

endmenu

endmenu
```
