## build/resource/Kconfig
```kconfig
menu "resource options"

config RESOURCE_INSTALL_BITMAP
	bool "install tiger.bmp"
	default n
	help
		"support install tiger.bmp"

menu "ai models resource"

menu "CV186X"

config RESOURCE_INSTALL_AI_CV186X_CLS_ATTRIBUTE_GENDER_AGE_GLASS_EMOTION
	bool "install cls_attribute_gender_age_glass_emotion"
	default n
	help
		"support install 186x cls_attribute_gender_age_glass_emotion"

config RESOURCE_INSTALL_AI_CV186X_FEATURE_CLIP_IMAGE
	bool "install feature_clip_image"
	default n
	help
		"support install 186x feature_clip_image"

config RESOURCE_INSTALL_AI_CV186X_FEATURE_CLIP_TEXT
	bool "install feature_clip_text"
	default n
	help
		"support install 186x feature_clip_text"

config RESOURCE_INSTALL_AI_CV186X_FEATURE_CVIFACE
	bool "install feature_cviface"
	default n
	help
		"support install 186x feature_cviface"

config RESOURCE_INSTALL_AI_CV186X_KEYPOINT_FACE
	bool "install keypoint_face"
	default n
	help
		"support install 186x keypoint_face"

config RESOURCE_INSTALL_AI_CV186X_SCRFD_DET_FACE
	bool "install scrfd_det_face"
	default n
	help
		"support install 186x scrfd_det_face"

config RESOURCE_INSTALL_AI_CV186X_TRACKING_FEARTRACK
	bool "install tracking_feartrack"
	default n
	help
		"support install 186x tracking_feartrack"

config RESOURCE_INSTALL_AI_CV186X_YOLOV8N_DET_MONITOR_PERSON
	bool "install yolov8n_det_monitor_person"
	default n
	help
		"support install 186x yolov8n_det_monitor_person"

config RESOURCE_INSTALL_AI_CV186X_YOLOV8N_DET_PERSON_VEHICLE
	bool "install yolov8n_det_person_vehicle"
	default n
	help
		"support install 186x yolov8n_det_person_vehicle"

endmenu

menu "BM1688"

config RESOURCE_INSTALL_AI_BM1688_CLS_ATTRIBUTE_GENDER_AGE_GLASS_EMOTION
	bool "install bm1688 cls_attribute_gender_age_glass_emotion"
	default n
	help
		"support install bm1688 cls_attribute_gender_age_glass_emotion"

config RESOURCE_INSTALL_AI_BM1688_FEATURE_CLIP_IMAGE
	bool "install bm1688 feature_clip_image"
	default n
	help
		"support install bm1688 feature_clip_image"

config RESOURCE_INSTALL_AI_BM1688_FEATURE_CLIP_TEXT
	bool "install bm1688 feature_clip_text"
	default n
	help
		"support install bm1688 feature_clip_text"

config RESOURCE_INSTALL_AI_BM1688_FEATURE_CVIFACE
	bool "install bm1688 feature_cviface"
	default n
	help
		"support install bm1688 feature_cviface"

config RESOURCE_INSTALL_AI_BM1688_KEYPOINT_FACE
	bool "install bm1688 keypoint_face"
	default n
	help
		"support install bm1688 keypoint_face"

config RESOURCE_INSTALL_AI_BM1688_SCRFD_DET_FACE
	bool "install bm1688 scrfd_det_face"
	default n
	help
		"support install bm1688 scrfd_det_face"

config RESOURCE_INSTALL_AI_BM1688_TRACKING_FEARTRACK
	bool "install bm1688 tracking_feartrack"
	default n
	help
		"support install bm1688 tracking_feartrack"

config RESOURCE_INSTALL_AI_BM1688_YOLOV8N_DET_MONITOR_PERSON
	bool "install bm1688 yolov8n_det_monitor_person"
	default n
	help
		"support install bm1688 yolov8n_det_monitor_person"

config RESOURCE_INSTALL_AI_BM1688_YOLOV8N_DET_PERSON_VEHICLE
	bool "install bm1688 yolov8n_det_person_vehicle"
	default n
	help
		"support install bm1688 yolov8n_det_person_vehicle"

endmenu

endmenu

menu "file recover"

config RESOURCE_INSTALL_H264_PCM_TEMPLATE
	bool "install h264 pcm template"
	default n
	help
		"support install record h264 & pcm fix file"

config RESOURCE_INSTALL_H265_PCM_TEMPLATE
	bool "install h265 pcm template"
	default n
	help
		"support install record h265 & pcm fix file"

config RESOURCE_INSTALL_MP4_AAC_TEMPLATE
	bool "install mp4 aac template"
	default n
	help
		"support install record mp4 & aac fix file"

endmenu

config RESOURCE_INSTALL_NETWORK_WWW
	bool "install www"
	default n
	help
		"support install www for websock"

menu "vdec files"

config RESOURCE_INSTALL_VDEC_FILES_H264
	bool "install 1080p.h264"
	default n
	help
		"support install 1080p.h264"

config RESOURCE_INSTALL_VDEC_FILES_H265
	bool "install enc-1-1.265"
	default n
	help
		"support install enc-1-1.265"

config RESOURCE_INSTALL_VDEC_FILES_JPG
	bool "install 1080p.jpg"
	default n
	help
		"support install 1080p.jpg"

config RESOURCE_INSTALL_VDEC_FILES_MJP
	bool "install 1080p.mjp"
	default n
	help
		"support install 1080p.mjp"

endmenu

menu "dpu files"

config RESOURCE_INSTALL_DPU_GRIDINFO_L
	bool "install gridinfoL.dat"
	default n
	help
		"support install gridinfoL.dat"

config RESOURCE_INSTALL_DPU_GRIDINFO_R
	bool "install gridinfoR.dat"
	default n
	help
		"support install gridinfoR.dat"

endmenu

menu "fisheye files"

config RESOURCE_INSTALL_FISHEYE_GRIDINFO_L
	bool "install L_grid_info dat"
	default n
	help
		"support install L_grid_info dat"

config RESOURCE_INSTALL_FISHEYE_GRIDINFO_R
	bool "install R_grid_info dat"
	default n
	help
		"support install R_grid_info dat"

config RESOURCE_INSTALL_FISHEYE_STITCH_BIN
	bool "install alpha beta bin"
	default n
	help
		"support install alpha beta bin"

endmenu

menu "param resource"

choice
prompt "Select FBM Parameter"

config RESOURCE_INSTALL_FBM_CV186AH_WEVB_GC4653
	bool "install fbm_cv186ah_wevb_gc4653"
	help
		"support install fbm cv186ah_wevb_gc4653.ini"

config RESOURCE_INSTALL_FBM_CV186AH_WEVB_GC4653_MULITRECORD
	bool "install fbm_cv186ah_wevb_gc4653_mulitrecord"
	help
		"support install fbm cv186ah_wevb_gc4653_mulitrecord.ini"

config RESOURCE_INSTALL_FBM_CV186AH_WEVB_SC4336P_SC4336P
	bool "install fbm_cv186ah_wevb_sc4336p_sc4336p"
	help
		"support install fbm cv186ah_wevb_sc4336p_sc4336p.ini"

config RESOURCE_INSTALL_FBM_CV186AH_WEVB_2OS04E10_2OV9282
	bool "install fbm_cv186ah_wevb_2os04e10_2ov9282"
	help
		"support install fbm cv186ah_wevb_2os04e10_2ov9282.ini"

config RESOURCE_INSTALL_FBM_CV186AH_WEVB_2OS04E10_2SC4336P
	bool "install fbm_cv186ah_wevb_2os04e10_2sc4336p"
	help
		"support install fbm cv186ah_wevb_2os04e10_2sc4336p.ini"

config RESOURCE_INSTALL_FBM_CV186AH_WEVB_GC4653_AI
	bool "install fbm_cv186ah_wevb_gc4653_ai"
	help
		"support install fbm cv186ah_wevb_gc4653_ai.ini"

config RESOURCE_INSTALL_FBM_CV186AH_WEVB_6IMX307
	bool "install fbm_cv186ah_wevb_6imx307"
	help
		"support install fbm cv186ah_wevb_6imx307.ini"

config RESOURCE_INSTALL_FBM_CV186AH_WEVB_2OV9282_DPU
	bool "install cv186ah_wevb_ov9282_ov9282_dpu"
	help
		"support install fbm cv186ah_wevb_ov9282_ov9282_dpu.ini"

config RESOURCE_INSTALL_FBM_CV186AH_WEVB_2OV9282_4OS05A20
	bool "install cv186ah_wevb_2ov9282_4os05a20"
	help
		"support install fbm cv186ah_wevb_2ov9282_4os05a20.ini"

config RESOURCE_INSTALL_FBM_CV186AH_WEVB_2SC438AI_3SC1330
	bool "install cv186ah_wevb_2sc438ai_3sc1330"
	help
		"support install fbm cv186ah_wevb_2sc438ai_3sc1330.ini"

config RESOURCE_INSTALL_FBM_CV186AH_WEVB_AUTOTEST
	bool "install cv186ah_wevb_autotest"
	help
		"support install fbm cv186ah_wevb_autotest.ini"

endchoice


endmenu

endmenu
```

## build/toolchain/Kconfig
```kconfig
menu "cross_compile options"

choice
	prompt "cross_compile"
	default TOOLCHAIN_MUSL_RISCV64

config TOOLCHAIN_GLIBC_RISCV64
	bool "riscv glibc toolchain 64bit"
	help
	  glibc library for riscv64(RISCV64).

config TOOLCHAIN_MUSL_RISCV64
	bool "riscv musl toolchain 64bit"
	help
	  musl library for riscv64(RISCV64).
	  select on compiler option through menuconfig
	  default value is false.

config TOOLCHAIN_GLIBC_32BIT_ARM
	bool "arm glibc toolchain 32bit"
	help
	  glibc library for arm(arm32)

config TOOLCHAIN_GLIBC_64BIT_ARM
	bool "arm glibc 64bit toolchain 64bit"
	help
	  glibc library for arm(arm64)

config TOOLCHAIN_GLIBC_ARM64_V930
	bool "arm glibc 64bit toolchain 9.3.0"
	help
	  glibc library for arm(arm64) version 9.3.0

config TOOLCHAIN_GLIBC_ARM64_V1131
	bool "arm glibc 64bit toolchain 11.3.1"
	help
	  glibc library for arm(arm64) version 11.3.1

endchoice

config CROSS_COMPILE
	string
	default "riscv64-unknown-linux-gnu-" if TOOLCHAIN_GLIBC_RISCV64
	default "riscv64-unknown-linux-musl-" if TOOLCHAIN_MUSL_RISCV64
	default "arm-linux-gnueabihf-" if TOOLCHAIN_GLIBC_32BIT_ARM
	default "aarch64-linux-gnu-" if TOOLCHAIN_GLIBC_64BIT_ARM
	default "aarch64-linux-" if TOOLCHAIN_GLIBC_ARM64_V930
	default "aarch64-none-linux-gnu-" if TOOLCHAIN_GLIBC_ARM64_V1131
	help
	  Cross compile toolchain.

endmenu
```

## configs/cv186ah_2sc438hai_3sc1330t_defconfig
```kconfig
CONFIG_TOOLCHAIN_GLIBC_ARM64_V1131=y
CONFIG_CROSS_COMPILE="aarch64-none-linux-gnu-"
CONFIG_STATIC_COMPILER_SUPPORT=y
CONFIG_SUPPORT_ATOMIC=y
CONFIG_SDK_DIR=""
CONFIG_MODULE_MEDIA_AUDIO=y
CONFIG_MODULE_MEDIA=y
CONFIG_MODULE_MEDIA_SYS=y
CONFIG_MODULE_MEDIA_VI=y
CONFIG_MODULE_MEDIA_VPSS=y
CONFIG_MODULE_MEDIA_GDC=y
CONFIG_MODULE_MEDIA_VENC=y
CONFIG_MODULE_MEDIA_OSD=y
CONFIG_MODULE_MEDIA_DPU=y
CONFIG_MODULE_PARAMPARSE=y
CONFIG_MODULE_COMMON=y
CONFIG_MODULE_CJSON=y
CONFIG_MODULE_MININI=y
CONFIG_MODULE_MBUF=y
CONFIG_MODULE_PERIPHERAL=y
CONFIG_MODULE_GPIO=y
CONFIG_MODULE_IRCUT=y
CONFIG_MODULE_RTSP=y
CONFIG_RESOURCE_INSTALL_FBM_CV186AH_WEVB_2SC438AI_3SC1330=y
CONFIG_SENSOR_SMS_SC438AI=y
CONFIG_SENSOR_SMS_SC438AI_SLAVE=y
CONFIG_SENSOR_SMS_SC1330=y
CONFIG_SENSOR_SMS_SC1330_SLAVE=y
CONFIG_SENSOR_SMS_SC1330_1L=y
CONFIG_SENSOR_SMS_SC1330_1L_SLAVE=y
CONFIG_RESOURCE_INSTALL_DPU_GRIDINFO_L=y
CONFIG_RESOURCE_INSTALL_DPU_GRIDINFO_R=y
```

## configs/cv186ah_gc4653_wevb_ai_defconfig
```kconfig
CONFIG_TOOLCHAIN_GLIBC_ARM64_V1131=y
CONFIG_CROSS_COMPILE="aarch64-none-linux-gnu-"
CONFIG_STATIC_COMPILER_SUPPORT=y
CONFIG_SUPPORT_ATOMIC=y
CONFIG_SDK_DIR=""
CONFIG_MODULE_MEDIA_AUDIO=y
CONFIG_MODULE_MEDIA=y
CONFIG_MODULE_MEDIA_SYS=y
CONFIG_MODULE_MEDIA_VI=y
CONFIG_MODULE_MEDIA_VPSS=y
CONFIG_MODULE_MEDIA_VENC=y
CONFIG_MODULE_MEDIA_OSD=y
CONFIG_MODULE_NETWORK=y
CONFIG_MODULE_PARAMPARSE=y
CONFIG_MODULE_COMMON=y
CONFIG_MODULE_CJSON=y
CONFIG_MODULE_MININI=y
CONFIG_MODULE_MBUF=y
CONFIG_MODULE_PERIPHERAL=y
CONFIG_MODULE_ADC=y
CONFIG_MODULE_GPIO=y
CONFIG_MODULE_IRCUT=y
CONFIG_MODULE_PWM=y
CONFIG_MODULE_RTSP=y
CONFIG_MODULE_AI=y
CONFIG_MODULE_AI_MD=n
CONFIG_MODULE_AI_PD=n
CONFIG_MODULE_AI_IRFAECE=n
CONFIG_MODULE_AI_FD_FACE=n
CONFIG_MODULE_AI_BABYCRY=n
CONFIG_MODULE_AI_OBJECT_TRACK=y
CONFIG_MODULE_AI_KEYPOINT_HAND_GESTURE=n
CONFIG_MODULE_AI_IMG_TXT_CLIP=n
CONFIG_RESOURCE_INSTALL_BITMAP=y
CONFIG_RESOURCE_INSTALL_NETWORK_WWW=y
CONFIG_RESOURCE_INSTALL_FBM_CV186AH_WEVB_GC4653_AI=y
CONFIG_SENSOR_GCORE_GC4653=y
CONFIG_RESOURCE_INSTALL_AI_CV186X_CLS_ATTRIBUTE_GENDER_AGE_GLASS_EMOTION=n
CONFIG_RESOURCE_INSTALL_AI_CV186X_FEATURE_CLIP_IMAGE=n
CONFIG_RESOURCE_INSTALL_AI_CV186X_FEATURE_CLIP_TEXT=n
CONFIG_RESOURCE_INSTALL_AI_CV186X_FEATURE_CVIFACE=n
CONFIG_RESOURCE_INSTALL_AI_CV186X_KEYPOINT_FACE=n
CONFIG_RESOURCE_INSTALL_AI_CV186X_SCRFD_DET_FACE=n
CONFIG_RESOURCE_INSTALL_AI_CV186X_YOLOV8N_DET_MONITOR_PERSON=n
CONFIG_RESOURCE_INSTALL_AI_CV186X_TRACKING_FEARTRACK=y
CONFIG_RESOURCE_INSTALL_AI_CV186X_YOLOV8N_DET_PERSON_VEHICLE=y
CONFIG_RESOURCE_INSTALL_AI_BM1688_CLS_ATTRIBUTE_GENDER_AGE_GLASS_EMOTION=n
CONFIG_RESOURCE_INSTALL_AI_BM1688_FEATURE_CLIP_IMAGE=n
CONFIG_RESOURCE_INSTALL_AI_BM1688_FEATURE_CLIP_TEXT=n
CONFIG_RESOURCE_INSTALL_AI_BM1688_FEATURE_CVIFACE=n
CONFIG_RESOURCE_INSTALL_AI_BM1688_KEYPOINT_FACE=n
CONFIG_RESOURCE_INSTALL_AI_BM1688_SCRFD_DET_FACE=n
CONFIG_RESOURCE_INSTALL_AI_BM1688_TRACKING_FEARTRACK=y
CONFIG_RESOURCE_INSTALL_AI_BM1688_YOLOV8N_DET_MONITOR_PERSON=n
CONFIG_RESOURCE_INSTALL_AI_BM1688_YOLOV8N_DET_PERSON_VEHICLE=y
```
